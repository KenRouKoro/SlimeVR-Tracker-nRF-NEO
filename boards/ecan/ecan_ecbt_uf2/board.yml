## boards/ecan/ecan_ecbt_uf2/board.yml
```yaml
# Copyright (c) 2024 Nordic Semiconductor ASA
# SPDX-License-Identifier: Apache-2.0

board:
  name: ecan_ecbt_uf2
  full_name: ECAN ECBT
  vendor: ecan
  socs:
    - name: nrf52840
      variants:
      - name: 'mag_i2c'
```

## boards/ecan/ecan_ecbt_uf2/ecan_ecbt_uf2_defconfig
```kconfig
# Copyright (c) 2024 Nordic Semiconductor ASA
# SPDX-License-Identifier: Apache-2.0

CONFIG_ARM_MPU=y
CONFIG_HW_STACK_PROTECTION=y
CONFIG_GPIO=y

CONFIG_SLIMEVR_USB_DEVICE_MANUFACTURER="ECAN"
CONFIG_SLIMEVR_USB_DEVICE_PRODUCT="ECAN ECBT Tracker"

CONFIG_BATTERY_USE_REG_BUCK_MAPPING=y
CONFIG_IGNORE_CHARGE_WAKE_ON_VBUS=y

CONFIG_MPSL=y
CONFIG_MPSL_FEM=y
CONFIG_MPSL_FEM_SIMPLE_GPIO=y

CONFIG_RADIO_TX_POWER=30

CONFIG_SENSOR_MAG_CAL_MIN_SAMPLES=200

#generate for adafruit uf2 bootloader flashing
CONFIG_BUILD_OUTPUT_UF2=y
```

## boards/foxapplication/foxsnacklitev2/board.yml
```yaml
# Copyright (c) 2024 Nordic Semiconductor ASA
# SPDX-License-Identifier: Apache-2.0

board:
  name: foxsnacklitev2_uf2
  full_name: FoxApplication FoxSnackLiteV2 Tracker
  vendor: foxapplication
  socs:
    - name: nrf52840
```

## boards/foxapplication/foxsnacklitev3/foxsnacklitev3_uf2_defconfig
```kconfig
# Copyright (c) 2024 Nordic Semiconductor ASA
# SPDX-License-Identifier: Apache-2.0

CONFIG_ARM_MPU=y
CONFIG_HW_STACK_PROTECTION=y

CONFIG_SLIMEVR_USB_DEVICE_MANUFACTURER="FoxApplication"
CONFIG_SLIMEVR_USB_DEVICE_PRODUCT="FoxSnackLiteV3 LSM6DSV Tracker"

CONFIG_BATTERY_USE_REG_BUCK_MAPPING=y
CONFIG_IGNORE_CHARGE_WAKE_ON_VBUS=y

# Sensor driver whitelist (BOM: LSM6DSV/ICM45686 + MMC5603/MMC5983/QMC6309/QMC5883)
CONFIG_SENSOR_IMU_DRIVERS_MINIMAL=y
CONFIG_SENSOR_DRV_LSM6DSV=y
CONFIG_SENSOR_DRV_ICM45686=y
CONFIG_SENSOR_MAG_DRIVERS_MINIMAL=y
CONFIG_SENSOR_DRV_MMC5603NJ=y
CONFIG_SENSOR_DRV_MMC5983MA=y
CONFIG_SENSOR_DRV_QMC6309=y
CONFIG_SENSOR_DRV_QMC5883L=y

#generate for adafruit uf2 bootloader flashing
CONFIG_BUILD_OUTPUT_UF2=y
CONFIG_FLASH_LOAD_OFFSET=0x1000
```
